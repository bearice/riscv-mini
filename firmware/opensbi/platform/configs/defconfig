## firmware/opensbi/platform/configs/defconfig
```kconfig
CONFIG_SBI_ECALL_TIME=y
CONFIG_SBI_ECALL_SRST=y
CONFIG_SBI_ECALL_DBCN=y
# CONFIG_SBI_ECALL_PMU is not set
# CONFIG_SBI_ECALL_CPPC is not set
# CONFIG_SBI_ECALL_SUSP is not set
# CONFIG_SBI_ECALL_DBTR is not set
# CONFIG_SBI_ECALL_SSE is not set
# CONFIG_SBI_ECALL_MPXY is not set
```

## firmware/uboot/board/riscv-mini/mega138k_ae350/Kconfig
```kconfig
if TARGET_MEGA138K_AE350

config SYS_CPU
	default "andes"

config SYS_BOARD
	default "mega138k_ae350"

config SYS_VENDOR
	default "riscv-mini"

config SYS_CONFIG_NAME
	default "mega138k_ae350"

config BOARD_SPECIFIC_OPTIONS # dummy
	def_bool y
	select RISCV_ANDES
	imply OF_HAS_PRIOR_STAGE

endif
```

## firmware/uboot/board/riscv-mini/riscv_mini/Kconfig
```kconfig
if TARGET_RISCV_MINI

config SYS_BOARD
	default "riscv_mini"

config SYS_VENDOR
	default "riscv-mini"

config SYS_CONFIG_NAME
	default "riscv_mini"

config RISCV_MINI_ETH_RING_DMA
	bool "Exclusive native descriptor ring Ethernet DMA"
	depends on LITEETH
	help
	  Build the ring backend for riscv-mini,liteeth-ring. PIO packet
	  access is excluded; select this to match a DMA-enabled SoC.

endif
```

## firmware/uboot/board/riscv-mini/riscv_mini/configs/riscv_mini_defconfig
```kconfig
CONFIG_RISCV=y
CONFIG_RISCV_SMODE=y
CONFIG_DEFAULT_DEVICE_TREE="u-boot"
CONFIG_OF_BOARD=y
CONFIG_SYS_TEXT_BASE=0x41100000
CONFIG_SYS_SDRAM_BASE=0x40000000
CONFIG_SYS_SDRAM_SIZE=0x07E00000
CONFIG_SYS_MALLOC_LEN=0x400000
CONFIG_STACKSIZE=0x400000
CONFIG_NR_DRAM_BANKS=1
CONFIG_CUSTOM_SYS_INIT_SP_ADDR=0x47D00000
CONFIG_BAUDRATE=115200
CONFIG_SERIAL=y
CONFIG_DM_SERIAL=y
CONFIG_LITEUART32_SERIAL=y
CONFIG_TIMER=y
CONFIG_RISCV_TIMER=y
CONFIG_TIMER_EARLY=y
CONFIG_RISCV_SMODE_TIMER_FREQ=60000000
CONFIG_DEBUG_UART=y
CONFIG_DEBUG_UART_BASE=0xf000a000
CONFIG_DEBUG_UART_REGISTER_OFFSET=0
CONFIG_DEBUG_UART_ANNOUNCE=y
CONFIG_PRE_CONSOLE_BUFFER=y
CONFIG_SBI_V01=y
CONFIG_CMD_BOOTI=y
CONFIG_CMD_MMC=y
CONFIG_CMD_FAT=y
CONFIG_CMD_EXT4=y
CONFIG_CMD_FS_GENERIC=y
CONFIG_DOS_PARTITION=y
CONFIG_MMC=y
CONFIG_FAT_WRITE=y
CONFIG_FS_EXT4=y
CONFIG_SYS_LONGHELP=y
CONFIG_SYS_PROMPT="riscv-mini> "
CONFIG_HUSH_PARSER=y
CONFIG_INITRD_TAG=y
CONFIG_AUTOBOOT=y
CONFIG_BOOTDELAY=3
# The OpenSBI-embedded DTB is handed to the kernel unchanged; the kernel
# linear map covers it (no-map only skips 0x41000000..0x410fffff).
CONFIG_BOOT="fatload mmc 0:1 0x42000000 Image; booti 0x42000000 - 0x41080000"
CONFIG_LOG=y
CONFIG_SPL=n
CONFIG_LTO=n
CONFIG_POSITION_INDEPENDENT=n
```

## firmware/uboot/configs/mega138k_ae350_defconfig
```kconfig
CONFIG_RISCV=y
CONFIG_SYS_MALLOC_LEN=0x200000
CONFIG_HAS_CUSTOM_SYS_INIT_SP_ADDR=y
CONFIG_TARGET_MEGA138K_AE350=y
CONFIG_MMC_AE350_SD=y
CONFIG_AE350_ETH=y
CONFIG_RISCV_SMODE=y
# CONFIG_RISCV_ISA_F is not set
# CONFIG_RISCV_ISA_ZAAMO is not set
# CONFIG_RISCV_ISA_ZALRSC is not set
# CONFIG_AVAILABLE_HARTS is not set
# CONFIG_EFI_LOADER is not set
CONFIG_BOOTDELAY=3
CONFIG_USE_BOOTCOMMAND=y
CONFIG_BOOTCOMMAND="run sdboot"
CONFIG_DISPLAY_CPUINFO=y
CONFIG_DISPLAY_BOARDINFO=y
CONFIG_HUSH_PARSER=y
CONFIG_SYS_PROMPT="ae350# "
CONFIG_CMD_MMC=y
CONFIG_CMD_PART=y
CONFIG_CMD_MII=y
CONFIG_CMD_PING=y
CONFIG_CMD_CACHE=y
CONFIG_CMD_FAT=y
CONFIG_EFI_PARTITION=y
CONFIG_ENV_OVERWRITE=y
CONFIG_NET_RANDOM_ETHADDR=y
# CONFIG_ANDES_L2_CACHE is not set
CONFIG_MMC=y
CONFIG_SYS_NS16550=y
# CONFIG_TOOLS_LIBCRYPTO is not set
# CONFIG_TOOLS_KWBIMAGE is not set
```
